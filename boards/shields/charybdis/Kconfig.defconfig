## boards/shields/charybdis/Kconfig.defconfig
```kconfig
if SHIELD_CHARYBDIS_DONGLE

config ZMK_KEYBOARD_NAME
	default "Charybdis"

config ZMK_SPLIT_ROLE_CENTRAL
	default y

endif

if SHIELD_CHARYBDIS_BT_RIGHT

config ZMK_KEYBOARD_NAME
	default "Charybdis"

config ZMK_SPLIT_BLE_ROLE_CENTRAL
	default y

endif

if SHIELD_CHARYBDIS_DONGLE || SHIELD_CHARYBDIS_LEFT || SHIELD_CHARYBDIS_RIGHT || SHIELD_CHARYBDIS_BT_RIGHT || SHIELD_CHARYBDIS_BT_LEFT

config ZMK_SPLIT
	default y
	
endif
```

## boards/shields/charybdis/Kconfig.shield
```kconfig
config SHIELD_CHARYBDIS_DONGLE
	def_bool $(shields_list_contains,charybdis_dongle)

config SHIELD_CHARYBDIS_LEFT
	def_bool $(shields_list_contains,charybdis_left)

config SHIELD_CHARYBDIS_RIGHT
	def_bool $(shields_list_contains,charybdis_right)

config SHIELD_CHARYBDIS_BT_RIGHT
	def_bool $(shields_list_contains,charybdis_bt_right)

config SHIELD_CHARYBDIS_BT_LEFT
	def_bool $(shields_list_contains,charybdis_bt_right)
```
